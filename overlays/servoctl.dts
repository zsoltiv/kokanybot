/dts-v1/;
/plugin/;

/ {
    compatible = "brcm,bcm2835";

    fragment@0 {
        target = <&i2c1>; // /dev/i2c-1
        __overlay__ {
            status = "okay";

            pca@40 { // 0x40
                compatible = "nxp,pca9685-pwm";
                #pwm-cells = <2>;
                reg = <0x40>;
            };
        };
    };
};
